#include <behaviors/mouse_keys.dtsi>
#include <behaviors.dtsi>
#include <dt-bindings/zmk/bt.h>
#include <dt-bindings/zmk/keys.h>
#include <dt-bindings/zmk/mouse.h>
#include <dt-bindings/zmk/rgb.h>

#define ZMK_MOUSE_DEFAULT_MOVE_VAL 1200  // 600
#define ZMK_MOUSE_DEFAULT_SCRL_VAL 20    // 10
#define U_MS_U &mmv MOVE_UP
#define U_MS_D &mmv MOVE_DOWN
#define U_MS_L &mmv MOVE_LEFT
#define U_MS_R &mmv MOVE_RIGHT

// 39 - rotator push / mute
// 6 - up, 19 - down, 32 - left, 43, - right, 47 push -- 5 way switch
// 0  1  2  3  4  5     6   7 8  9  10 11 12
// 13 14 15 16 17 18   19  20 21 22 23 24 25
// 26 27 28 29 30 31   32  33 34 35 36 37 38
//       39 40 41 42   43  44 45 46   
//                     47 

#define KEYS_L 0 1 2 3 4 5 13 14 15 16 17 18 26 27 28 29 30 31
#define KEYS_R 7 8 9 10 11 12 20 21 22 23 24 25 33 34 35 36 37 38 
#define THUMBS 40 41 42 44 45 46

        td0: td0 {
            compatible = "zmk,behavior-tap-dance";
            label = "TD0";
            #binding-cells = <0>;
            bindings = <&kp LEFT_SHIFT>, <&kp CAPS>;
        };
        
        hml: homerow_mods {
            compatible = "zmk,behavior-hold-tap";
            label = "HOMEROW_MODS_LEFT";

            flavor = "balanced";
            tapping-term-ms = <280>;
            quick-tap-ms = <175>;
            require-prior-idle-ms = <150>;
            bindings = <&kp>, <&kp>;
            hold-trigger-key-positions = <KEYS_R THUMBS>;
            hold-trigger-on-release;
        };

        hmr: homerow_mods {
            compatible = "zmk,behavior-hold-tap";
            label = "HOMEROW_MODS_RIGHT";

            flavor = "balanced";
            tapping-term-ms = <280>;
            quick-tap-ms = <175>;
            require-prior-idle-ms = <150>;
            bindings = <&kp>, <&kp>;
            hold-trigger-key-positions = <KEYS_L THUMBS>;
            hold-trigger-on-release;
        };

        hm: homerow_mods {
            compatible = "zmk,behavior-hold-tap";
            label = "HOMEROW_MODS";
            bindings = <&kp>, <&kp>;

            #binding-cells = <2>;
            tapping-term-ms = <200>;
            quick-tap-ms = <180>;
            flavor = "tap-preferred";
            require-prior-idle-ms = <100>;
        };

        mmv {
            acceleration-exponent = <1>;      // 1
            time-to-max-speed-ms = <900>;    // 40
            delay-ms = <0>;                   // 0
        };

        msc {
            acceleration-exponent = <1>;      // 0
            time-to-max-speed-ms = <400>;      // 500
            delay-ms = <0>;                   // 10
        };
    };

    rgb_encoder: rgb_encoder {
        compatible = "zmk,behavior-sensor-rotate";
        label = "RGB_ENCODER";
        #sensor-binding-cells = <0>;
        bindings = <&rgb_ug RGB_BRI>, <&rgb_ug RGB_BRD>;
    };

    scroll_encoder: scroll_encoder {
        compatible = "zmk,behavior-sensor-rotate";
        #sensor-binding-cells = <0>;
        bindings = <&msc SCRL_DOWN>, <&msc SCRL_UP>;

        tap-ms = <30>;
    };

    combos {
        compatible = "zmk,combos";

        esc {
            bindings = <&kp ESCAPE>;
            key-positions = <1 2>;
        };
    };

    keymap {
        compatible = "zmk,keymap";

        default_layer {
            display-name = "DVRK";

            // --------------------------------------------------------------------------------
            // |  TAB |  Q  |  W  |  E  |  R  |  T  |                ↑    |  Y  |  U   |  I  |  O  |  P  | BKSP |      &kp UP_ARROW 
            // | SHIFT |  A  |  S  |  D  |  F  |  G  |               ↓    |  H  |  J   |  K  |  L  |  ;  |  '   | 
            // | CTRL |  Z  |  X  |  C  |  V  |  B  |                ←    |  N  |  M   |  ,  |  .  |  /  | ESC  |
            //                    | GUI | LWR | SPC |                →    | ENT | RSE  | ALT |
            //                                                      enter

            bindings = <
&kp TAB    &kp SEMI     &kp COMMA   &kp DOT     &kp P         &kp Y        &kp UP_ARROW     &kp F      &kp G        &kp C       &kp R       &kp L        &kp BSPC
&kp LCTRL  &hml LCTRL A  &hml LALT O  &hml LGUI E  &hml LSHIFT U  &kp I     &kp DOWN_ARROW   &kp D      &hmr RSHFT H  &hmr RGUI T  &hmr RALT N  &hmr RCTRL S  &kp MINUS
&td0       &kp SQT      &kp Q       &kp J       &kp K         &kp X        &kp LEFT_ARROW   &kp B      &kp M        &kp W       &kp V       &kp Z        &kp RSHIFT
                        &kp C_MUTE  &kp LGUI    &mo 3         &kp SPACE    &kp RIGHT_ARROW  &kp ENTER  &mo 2        &kp RALT
                                                                           &kp ENTER
            >;

            label = "DVRK";
            sensor-bindings = <&inc_dec_kp C_VOLUME_UP C_VOLUME_DOWN>;
        };

        QWERTY {
            display-name = "QWERTY";
            bindings = <
            >;

            label = "DVRK";
            sensor-bindings = <&inc_dec_kp C_VOLUME_UP C_VOLUME_DOWN>;
        };

        QWERTY {
            display-name = "QWERTY";
            bindings = <
&trans  &kp Q  &kp W       &kp E     &kp R  &kp T        &trans  &kp Y      &kp U  &kp I      &kp O    &kp P     &trans
&trans  &kp A  &kp S       &kp D     &kp F  &kp G        &trans  &kp H      &kp J  &kp K      &kp L    &kp SEMI  &trans
&trans  &kp Z  &kp X       &kp C     &kp V  &kp B        &trans  &kp N      &kp M  &kp COMMA  &kp DOT  &kp FSLH  &trans
               &kp C_MUTE  &kp LGUI  &mo 3  &kp SPACE    &trans  &kp ENTER  &mo 2  &kp RALT
                                                         &trans
            >;

            label = "QWERTY";
            sensor-bindings = <&inc_dec_kp C_VOLUME_UP C_VOLUME_DOWN>;
        };

        NUMBER {
            display-name = "NUM";

            // -----------------------------------------------------------------------------------------
            // |  TAB |  1  |  2  |  3  |  4  |  5  |   |  6  |  7  |  8  |  9  |  0  | BKSP |
            // | BTCLR| BT1 | BT2 | BT3 | BT4 | BT5 |   | LFT | DWN |  UP | RGT |     |      |
            // | SHFT |     |     |     |     |     |   |     |     |     |     |     |      |
            //                    | GUI |     | SPC |   | ENT |     | ALT |

            bindings = <
&trans  &kp N1        &kp N2      &kp N3  &kp N4  &kp N5        &mmv MOVE_UP     &kp N6    &kp N7    &kp N8  &kp N9     &kp N0  &trans
&trans  &kp NUMBER_6  &kp N7      &kp N8  &kp N9  &kp N0        &mmv MOVE_DOWN   &kp LEFT  &kp DOWN  &kp UP  &kp RIGHT  &trans  &trans
&trans  &trans        &trans      &trans  &trans  &kp KP_DOT    &mmv MOVE_LEFT   &trans    &trans    &trans  &trans     &trans  &trans
                      &kp C_MUTE  &trans  &trans  &trans        &mmv MOVE_RIGHT  &trans    &trans    &trans
                                                                &mkp LCLK
            >;

            label = "NUM";
            sensor-bindings = <&scroll_encoder>;
        };

        SYMBOL {
            display-name = "SYM";

            // -----------------------------------------------------------------------------------------
            // |  TAB |  !  |  @  |  #  |  $  |  %  |   |  ^  |  &  |  *  |  (  |  )  | BKSP |
            // | CTRL |     |     |     |     |     |   |  -  |  =  |  [  |  ]  |  \  |  `   |
            // | SHFT |     |     |     |     |     |   |  _  |  +  |  {  |  }  | "|" |  ~   |
            //                    | GUI |     | SPC |   | ENT |     | ALT |

            bindings = <
&kp TILDE  &kp PLUS         &kp LBKT  &kp LBRC  &kp LPAR     &kp AMPS    &mmv MOVE_UP     &kp EQUAL  &kp RPAR      &kp RBRC   &kp RBKT      &kp SLASH       &trans
&trans     &kp EXCLAMATION  &kp AT    &kp HASH  &kp PERCENT  &kp PIPE    &mmv MOVE_DOWN   &kp PIPE   &kp CARET     &kp GRAVE  &kp ASTERISK  &kp DOLLAR      &kp MINUS
&trans     &trans           &trans    &none     &trans       &trans      &mmv MOVE_LEFT   &trans     &kp QUESTION  &trans     &kp BSLH      &kp UNDERSCORE  &trans
                            &trans    &trans    &trans       &trans      &mmv MOVE_RIGHT  &trans     &trans        &trans
                                                                         &mkp LCLK
            >;

&kp C_AC_NEXT_KEYBOARD_LAYOUT_SELECT  &kp F11  &kp F12     &none         &tog 1  &bootloader    &mmv MOVE_LEFT   &bootloader  &kp C_BRI_DEC     &kp C_BRIGHTNESS_INC  &none         &none         &tog 5
                                               &kp C_MUTE  &kp LEFT_GUI  &none   &none          &mmv MOVE_RIGHT  &none        &none             &kp RALT
                                                                                                &mkp LCLK
            >;

            label = "FN";
            sensor-bindings = <&inc_dec_kp C_FAST_FORWARD C_REWIND>;
        };

        SYSTEM {
            label = "SYS";
            display-name = "SYS";
            bindings = <
&trans  &rgb_ug RGB_HUD  &rgb_ug RGB_HUI  &rgb_ug RGB_SPD  &rgb_ug RGB_SPI  &none     &mmv MOVE_UP     &none           &none  &none   &none  &none  &bt BT_CLR
&trans  &rgb_ug RGB_HUD  &rgb_ug RGB_HUI  &rgb_ug RGB_EFR  &rgb_ug RGB_EFF  &none     &mmv MOVE_DOWN   &none           &none  &none   &none  &none  &none
&none   &rgb_ug RGB_OFF  &rgb_ug RGB_ON   &none            &none            &none     &mmv MOVE_LEFT   &bt BT_CLR_ALL  &none  &none   &none  &to 0  &none
                         &rgb_ug RGB_TOG  &trans           &mo 3            &trans    &mmv MOVE_RIGHT  &trans          &mo 2  &trans
                                                                                      &mkp LCLK
            >;

            sensor-bindings = <&rgb_encoder>;
        };
    };

    conditional_layers {
        compatible = "zmk,conditional-layers";

        layer3 {
            if-layers = <2 3>;
            then-layer = <4>;
        };
    };
};
